/dts-v1/;
/plugin/;

/ {
    compatible = "brcm,bcm2835";

    fragment@0 {
        target = <&gpio>;
        __overlay__ {
          uart0_rts_gpio17: uart0_rts_gpio17 {
            brcm,pins = <17>;
            brcm,function = <7>; // alt 3
          };
        };
    };

    fragment@1 {
        target = <&uart0>;
        __overlay__ {
                pinctrl-names = "default";
                pinctrl-0 = <&uart0_rts_gpio17>;
        };
    };
};