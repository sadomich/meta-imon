/dts-v1/;
/plugin/;

/ {
 compatible = "brcm,bcm2835";

 fragment@0 {
  target = <&i2c0>;
  __overlay__ {
   #address-cells = <1>;
   #size-cells = <0>;

   status = "okay";

   mcp3424: mcp@6c {
    reg = <0x6c>;
    compatible = "microchip,mcp3424";
    status = "okay";
   };
  };
 };
};
