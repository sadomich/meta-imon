## conf/distro/imon.conf
```bitbake
DISTRO = "imon"
DISTRO_NAME = "iMonOS"
DISTRO_VERSION = "1.0.0"

IMAGE_NAME:append = "-${DISTRO}-${DISTRO_VERSION}"

PACKAGE_CLASSES = "package_deb"

DEFAULT_TIMEZONE = "Europe/Warsaw"

GLIBC_GENERATE_LOCALES = "en_US.UTF-8"
IMAGE_LINGUAS ?= "en-us"

DISTRO_FEATURES:remove = " \
	x11 \
	wayland \
	pulseaudio \
	directfb \
	bluetooth \
	irda \
	nfs \
	alsa \
	ipv6 \
	phone \
	ipsec \
	nfc \
	smbfs \
	wifi \
	3g \
	"

DISTRO_FEATURES:append = " pam systemd rauc"

# Define Init System
INIT_MANAGER = "systemd"

VIRTUAL-RUNTIME_dev-manager = "udev"
VIRTUAL-RUNTIME_init_manager = "systemd"
VIRTUAL-RUNTIME_initscripts = "systemd-compat-units"

VOLATILE_LOG_DIR = "no"

RPI_USE_U_BOOT = "1"

LICENSE_FLAGS_ACCEPTED = "synaptics-killswitch"

WIC_CREATE_EXTRA_ARGS ?= "--no-fstab-update"

ROOT_PASSWD = "\$6\$0GpXXsc/QYQql$Lrca/3.m55tK2.eaUmL9Q3enzflTKx2Bu/lu8JwvQWigqIFZaRCB5YJL164zsgxNYduYJue14muT0g.q0UR8l/"
IMON_PASSWD = "\$6\$1U9BK8qr8U5d22$Q8f4oU7UQV6KFgPWtqx1ilzh2qsn/df2Xp.y1LD5XNizUZ6z0cUy4z8laVn6B7K/zA9UcOHrldmqoO74efLn7/"

BOOT_SPACE = "1073741"
INITRAMFS_MAXSIZE = "315400"

# TODO move to machine configuration
IMAGE_BOOT_FILES:remove="Image"

LICENSE_FLAGS_ACCEPTED += " commercial license"
```

## conf/machine/include/base-pigeon.conf
```bitbake
include conf/machine/include/common.conf

KERNEL_MODULE_AUTOLOAD:rpi += "i2c-dev i2c-bcm2708"

MACHINE_EXTRA_RRECOMMENDS += "udev-rules-pigeon"

ENABLE_I2C = "1"
ENABLE_SPI_BUS = "1"
ENABLE_UART = "1"

PIGEON_EXTRA_CONFIG = '\n\
# Pigeon extra config\n\
ignore_lcd=1\n\
force_eeprom_read=0\n\
disable_poe_fan=1\n\
\n\
# LED-ACT\n\
dtparam=act_led_trigger=heartbeat\n\
\n\
# RTC\n\
dtoverlay=i2c-rtc,pcf8563\n\
\n\
# UPS\n\
[gpio27=1]\n\
dtoverlay=gpio-poweroff,gpiopin=4,active_low=1\n\
dtoverlay=gpio-shutdown,gpio_pin=27,active_low=1,gpio_pull=up,debounce=1500\n\
\n\
## HDMI ##\n\
# [gpio27=0]\n\
# hdmi=off\n\
'
```

## conf/machine/include/common.conf
```bitbake
SPLASH = ""
DISABLE_SPLASH = "1"

COMMON_CONFIG = '\n\
# Enable watchdog on boot\n\
dtparam=watchdog=on\n\
'

RPI_EXTRA_CONFIG:append = '${COMMON_CONFIG}'

PREFERRED_VERSION_linux-raspberrypi ?= "6.6.%"
```

## conf/machine/rb350-64.conf
```bitbake
#@TYPE: Machine
#@NAME: Pigeon RB350 Board (64 bits)
#@DESCRIPTION: Machine configuration for Pigeon RB350 Board

MACHINEOVERRIDES = "raspberrypi3-64:${MACHINE}"
include conf/machine/raspberrypi3-64.conf
include conf/machine/include/base-pigeon.conf

WKS_FILE = "imon-msdos-emmc-4g.wks"

KERNEL_DEVICETREE:append = " overlays/mcp2515-can0.dtbo"
KERNEL_DEVICETREE:append = " overlays/gpio-led.dtbo"

ENABLE_CAN = "1"

ENABLE_I2C = "1"
ENABLE_SPI_BUS = "1"
ENABLE_UART = "1"

SERIAL_CONSOLES = ""

DISABLE_VC4GRAPHICS = "1"
#ENABLE_W1 = "1"

RB350_EXTRA_CONFIG:append = '\n\
# RB350 GPIO CONFIG\n\
gpio=0=op,pd,dl\n\
gpio=1=op,pd,dl\n\
gpio=2=a0,pu\n\
gpio=3=a0,pu\n\
gpio=4=op,pu,dh\n\
gpio=5=op,np,dh\n\
gpio=6=op,np,dh\n\
gpio=7=a0,pu\n\
gpio=8=a0,pu\n\
gpio=9=a0,pu\n\
gpio=10=a0,pu\n\
gpio=11=a0,pu\n\
gpio=12=ip,np\n\
gpio=13=ip,np\n\
gpio=14=a0,np\n\
gpio=15=a0,pu\n\
gpio=16=a3,np\n\
gpio=17=a3,pu\n\
gpio=18=ip,np\n\
gpio=19=ip,np\n\
gpio=20=ip,np\n\
gpio=21=ip,np\n\
gpio=22=ip,np\n\
gpio=23=ip,np\n\
gpio=24=ip,np\n\
gpio=25=ip,np\n\
gpio=26=ip,np\n\
gpio=27=ip,pd\n\
gpio=28=op,pd,dl\n\
gpio=29=op,pd,dl\n\
gpio=30=ip,pd\n\
gpio=31=ip,pd\n\
gpio=32=ip,pd\n\
gpio=33=ip,pd\n\
gpio=34=op,pd,dl\n\
gpio=35=op,pd,dl\n\
gpio=36=op,pd,dl\n\
gpio=37=op,pd,dl\n\
gpio=38=op,pd,dl\n\
gpio=39=op,pd,dl\n\
gpio=40=op,pd,dl\n\
gpio=41=op,pd,dl\n\
gpio=42=op,pd,dl\n\
gpio=43=ip,pu\n\
gpio=44=op,pu,dh\n\
gpio=45=op,pd,dl\n\
\n\
# RB350 INTERFACES\n\
dtoverlay=mcp2515-can0,interrupt=25\n\
\n\
# UART\n\
dtoverlay=pi3-miniuart-bt\n\
dtparam=uart1=on\n\
\n\
## LED-USR ##\n\
dtoverlay=gpio-led,gpio=0,label=led-usr\n\
\n\
'

RPI_EXTRA_CONFIG:append = '${PIGEON_EXTRA_CONFIG}\n${RB350_EXTRA_CONFIG}'
```

## conf/machine/rb700-64.conf
```bitbake
#@TYPE: Machine
#@NAME: Pigeon RB700 Board (64 bits)
#@DESCRIPTION: Machine configuration for Pigeon RB700 Board

MACHINEOVERRIDES = "raspberrypi4-64:${MACHINE}"
include conf/machine/raspberrypi4-64.conf
include conf/machine/include/base-pigeon.conf

WKS_FILE = "imon-gpt-emmc.wks"

KERNEL_DEVICETREE:append = " overlays/pigeon-led-usr-cm4.dtbo overlays/pigeon-led-cm4.dtbo overlays/pigeon-tpm.dtbo overlays/pigeon-eeprom.dtbo"
KERNEL_DEVICETREE:append = " overlays/mcp251xfd.dtbo overlays/spi1-1cs.dtbo overlays/mcp23017.dtbo"

ENABLE_DWC2_HOST = "1"

RB700_EXTRA_CONFIG = '\n\
# RB700 GPIO config\n\
gpio=0=a0,pu\n\
gpio=1=a0,pu\n\
gpio=2=a0,pu\n\
gpio=3=a0,pu\n\
gpio=4=op,pu,dh\n\
gpio=5=op,np,dh\n\
gpio=6=op,pd,dl\n\
gpio=7=a0,pu\n\
gpio=8=a0,pu\n\
gpio=9=a0,pu\n\
gpio=10=a0,pu\n\
gpio=11=a0,pu\n\
gpio=12=ip,pd\n\
gpio=13=ip,pd\n\
gpio=14=a0,np\n\
gpio=15=a0,pu\n\
gpio=16=ip,pd\n\
gpio=17=ip,pd\n\
gpio=18=a4\n\
gpio=19=a4\n\
gpio=20=a4\n\
gpio=21=a4\n\
gpio=22=op,pd,dl\n\
gpio=23=ip,pu\n\
gpio=24=ip,pu\n\
gpio=25=ip,np\n\
gpio=26=op,pd,dl\n\
gpio=27=ip,pd\n\
gpio=44=op,pu,dh\n\
gpio=45=op,pd,dl\n\
\n\
# CM4 INTERFACES\n\
dtoverlay=mcp251xfd,spi0-0,interrupt=25,oscillator=40000000\n\
dtoverlay=spi1-1cs,cs0_spidev=off\n\
dtoverlay=pigeon-tpm\n\
dtoverlay=pigeon-eeprom\n\
dtoverlay=mcp23017,addr=0x20,gpiopin=23\n\
dtoverlay=pigeon-led-usr-cm4\n\
dtoverlay=pigeon-led-cm4\n\
\n\
'

RPI_EXTRA_CONFIG:append = '${PIGEON_EXTRA_CONFIG}\n${RB700_EXTRA_CONFIG}'
```

## conf/machine/x500-64.conf
```bitbake
#@TYPE: Machine
#@NAME: NPE X500 M3 (CM3)
#@DESCRIPTION: Machine configuration for NPE X500 M3 board (CM3)

MACHINEOVERRIDES = "raspberrypi3-64:${MACHINE}"
include conf/machine/raspberrypi3-64.conf
include conf/machine/include/common.conf

WKS_FILE = "imon-msdos-emmc-4g.wks"

KERNEL_MODULE_AUTOLOAD += "i2c-dev i2c-bcm2708 mcp3422 rtc_ds1307"

KERNEL_DEVICETREE:append = " overlays/x500-adc.dtbo overlays/x500-hdmi.dtbo overlays/x500-led.dtbo overlays/x500-nxp-uart.dtbo overlays/x500-rtc.dtbo overlays/x500-uart0-rs485.dtbo overlays/x500-mcp230xx.dtbo"

ENABLE_I2C = "1"
ENABLE_SPI_BUS = "1"
ENABLE_UART = "1"

SERIAL_CONSOLES = ""

DISABLE_VC4GRAPHICS = "1"
#ENABLE_W1 = "1"

NPE_EXTRA_CONFIG = '\n\
# PCIE MODEM\n\
gpio=30=op,pd,dl\n\
gpio=31=op,pu,dh\n\
# NXP uart\n\
gpio=26=op,pu,dh\n\
\n\
# NPE x500 extra config\n\
dtoverlay=x500\n\
dtoverlay=dwc2,dr_mode=host\n\
dtparam=i2c_arm=on\n\
dtparam=i2c0=on\n\
i2c0_baudrate=400000\n\
\n\
# UART\n\
dtoverlay=pi3-miniuart-bt\n\
dtparam=uart1=on\n\
\n\
dtoverlay=x500-adc\n\
dtoverlay=x500-hdmi\n\
dtoverlay=x500-led\n\
dtoverlay=x500-nxp-uart\n\
dtoverlay=x500-uart0-rs485\n\
dtoverlay=x500-rtc\n\
# i2c DIO\n\
dtoverlay=x500-mcp230xx\n\
'

RPI_EXTRA_CONFIG:append = '${NPE_EXTRA_CONFIG}'
```

## wic/imon-msdos-emmc.wks
```
# The mmc storage layout:
# ---------------------------------------------------------------------
# | bootA | bootB | uboot env | rootfsA | rootfsB | /var/log | /data  |
# ---------------------------------------------------------------------

part /boot --source bootimg-partition --ondisk mmcblk0 --fstype=vfat --label boot_A --active --align 4096 --fixed-size 50M --no-fstab-update
part --ondisk mmcblk0 --label boot_B --align 4096 --no-table --fixed-size 50M
part /uboot_env --source rawcopy --sourceparams="file=ubootenv.vfat" --fstype=vfat --ondisk mmcblk0 --label uboot_env --align 4096 --fixed-size 10M --no-fstab-update
part --fixed-size 128M --source rawcopy --sourceparams="file=kernel.ext4" --ondisk ${DISK_DRIVE_NAME} --fstype=ext4 --mkfs-extraopts="-b 4096" --label kernel_A --align 4096
part --fixed-size 128M --ondisk ${DISK_DRIVE_NAME} --fstype=ext4 --mkfs-extraopts="-b 4096" --label kernel_B --align 4096
part / --source rootfs --ondisk mmcblk0 --fstype=ext4 --label rootfs_A --align 4096 --fixed-size 2048M
part --ondisk mmcblk0 --fstype=ext4 --label rootfs_B --align 4096 --fixed-size 2048M
part /var/log --source rootfs --rootfs-dir=${IMAGE_ROOTFS}/var/log --ondisk mmcblk0 --fstype=ext4 --mkfs-extraopts="-b 4096" --label log --align 4096 --fixed-size 1024M --no-fstab-update
part /data --source rootfs --rootfs-dir=${IMAGE_ROOTFS}/data --ondisk mmcblk0 --fstype=btrfs --label data --align 4096 --fsoptions "x-systemd.growfs" --fixed-size 128M --no-fstab-update
```
